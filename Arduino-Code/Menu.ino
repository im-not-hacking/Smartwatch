//Get bitmaps

//HOUSE
const unsigned char h_symbol [] PROGMEM = {
  0x00, 0x00, 0x00, 0x00, 0x00, 0x00, 0x00, 0x00, 0x00, 0x00, 0x00, 0x00, 0x00, 0x00, 0x00, 0x00, 
  0x00, 0x00, 0x00, 0x00, 0x00, 0x00, 0x00, 0x00, 0x00, 0x00, 0x00, 0x00, 0x00, 0x00, 0x00, 0x00, 
  0x00, 0x00, 0x00, 0x00, 0x00, 0x00, 0x00, 0x00, 0x00, 0x00, 0x00, 0x00, 0x00, 0x00, 0x00, 0x00, 
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  0x00, 0x00, 0x00, 0x00, 0x00, 0x00, 0x00, 0x00, 0x00, 0x00, 0x00, 0x00, 0x00, 0x00
};

// 'placitech_logo', 50x50px
const unsigned char placitlogo [] PROGMEM = {
  0x00, 0x00, 0x00, 0x00, 0x00, 0x00, 0x00, 0x00, 0x00, 0x00, 0x00, 0x00, 0x00, 0x00, 0x00, 0x00, 
  0x00, 0x00, 0x00, 0x00, 0x00, 0x00, 0x00, 0x00, 0x00, 0x00, 0x00, 0x00, 0x00, 0x00, 0x00, 0x00, 
  0x00, 0x00, 0x00, 0x00, 0x00, 0x00, 0x00, 0x00, 0x00, 0x00, 0x00, 0x00, 0x00, 0x00, 0x00, 0x00, 
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  0x00, 0x00, 0x00, 0x00, 0x00, 0x00, 0x00, 0x00, 0x00, 0x00, 0x00, 0x00, 0x00, 0x00
};

// 'gear_settings', 19x19px
const unsigned char gear_s [] PROGMEM = {
  0x00, 0x00, 0x00, 0x01, 0x30, 0x00, 0x03, 0xb0, 0x00, 0x03, 0xfe, 0x00, 0x1f, 0xbf, 0x00, 0x1e, 
  0x0e, 0x00, 0x0c, 0x06, 0x00, 0x38, 0x03, 0x80, 0x78, 0x03, 0xc0, 0x78, 0x03, 0x00, 0x18, 0x03, 
  0x00, 0x18, 0x03, 0x80, 0x3c, 0x07, 0x80, 0x3e, 0x0e, 0x00, 0x07, 0xfe, 0x00, 0x07, 0xfe, 0x00, 
  0x06, 0x64, 0x00, 0x00, 0x60, 0x00, 0x00, 0x00, 0x00
};

// 'gear_settings', 128x128px
const unsigned char gear_b [] PROGMEM = {
  0x00, 0x00, 0x00, 0x00, 0x00, 0x00, 0x00, 0x00, 0x00, 0x00, 0x00, 0x00, 0x00, 0x00, 0x00, 0x00, 
  0x00, 0x00, 0x00, 0x00, 0x00, 0x00, 0x00, 0x00, 0x00, 0x00, 0x00, 0x00, 0x00, 0x00, 0x00, 0x00, 
  0x00, 0x00, 0x00, 0x00, 0x00, 0x00, 0x00, 0x00, 0x00, 0x00, 0x00, 0x00, 0x00, 0x00, 0x00, 0x00, 
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  0x00, 0x00, 0x00, 0x00, 0x00, 0x00, 0x00, 0x00, 0x00, 0x00, 0x00, 0x00, 0x00, 0x00, 0x00, 0x00
};

// 'flashlight', 128x128px
const unsigned char flash_b [] PROGMEM = {
  0x00, 0x00, 0x00, 0x00, 0x00, 0x00, 0x00, 0x00, 0x00, 0x00, 0x00, 0x00, 0x00, 0x00, 0x00, 0x00, 
  0x00, 0x00, 0x00, 0x00, 0x00, 0x00, 0x00, 0x00, 0x00, 0x00, 0x00, 0x00, 0x00, 0x00, 0x00, 0x00, 
  0x00, 0x00, 0x00, 0x00, 0x00, 0x00, 0x00, 0x00, 0x00, 0x00, 0x00, 0x00, 0x00, 0x00, 0x00, 0x00, 
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  0x00, 0x00, 0x00, 0x00, 0x00, 0x00, 0x00, 0x00, 0x00, 0x00, 0x00, 0x00, 0x00, 0x00, 0x00, 0x00
};



const unsigned char sunlogo [] PROGMEM = {
  0, 0, 0, 0, 0, 0, 0, 0, 0, 0, 0, 0,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 0
};

const unsigned char musiclogo [] PROGMEM = {
  0, 0, 0, 0, 0, 0, 0, 0, 0, 0, 0, 0,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 0
};

const unsigned char enginelogo [] PROGMEM = {
  0, 0, 0, 0, 0, 0, 0, 0, 0, 0, 0, 0,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 0
};

const unsigned char flashlogo [] PROGMEM = {
  0, 0, 0, 0, 0, 0, 0, 0, 0, 0, 0, 0,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 0
};

void drawHomoRectY(int x0,int y0,int x1, int y1, int w,int color){
  Oled.drawLine(x0,y0,x1,y1,color);
  for (int i =1;i<w+1; i++){
    Oled.drawLine(x0,y0+i,x1,y1+i,color);
    Oled.drawLine(x0,y0-i,x1,y1-i,color);
  }
}

void drawHomoRectX(int x0,int y0,int x1, int y1, int w,int color){
  Oled.drawLine(x0,y0,x1,y1,color);
  for (int i =1;i<w+1; i++){
    Oled.drawLine(x0+i,y0,x1+i,y1,color);
    Oled.drawLine(x0-i,y0,x1-i,y1,color);
  }
}

void drawHomoRectXYP(int x0,int y0,int x1, int y1, int w,int color){
  for (int i =1;i<w+1; i++){
    Oled.drawLine(x0+i,y0-i,x1+i,y1-i,color);
    Oled.drawLine(x0-i,y0+i,x1-i,y1+i,color);
  }
  Oled.drawLine(x0,y0,x1,y1,color);
}

void drawHomoRectXY(int x0,int y0,int x1, int y1, int w,int color){
  for (int i =1;i<w+1; i++){
    Oled.drawLine(x0+i,y0+i,x1+i,y1+i,color);
    Oled.drawLine(x0-i,y0-i,x1-i,y1-i,color);
  }
  Oled.drawLine(x0,y0,x1,y1,color);
}

void drawlocation(int x, int y, int color, int BIG=false){
  if(BIG){
    Oled.fillTriangle(x-20,y-16,x+20,y-16,x,y+32,WHITE);
    Oled.fillCircle(x,y-16,20, WHITE);
    Oled.fillCircle(x,y-16,10,color);
  }
  else{
    Oled.fillTriangle(x-4,y-3,x+4,y-3,x,y+6,WHITE);
    Oled.fillCircle(x,y-3,4,WHITE);
    Oled.fillCircle(x,y-3,2,color);
  }
}

void drawheart(int x, int y, int color, int BIG=false){
  if(BIG){
    Oled.fillTriangle(x-35,y-2,x+35,y-2,x,y+32,WHITE);
    Oled.fillCircle(x-20,y-16,20,WHITE);
    Oled.fillCircle(x+20,y-16,20,WHITE);
    Oled.fillCircle(64,64,12,WHITE);
  }
  else{
    Oled.fillTriangle(x-5,y,x+5,y,x,y+6,WHITE);
    Oled.fillCircle(x-4,y-2,3,WHITE);
    Oled.fillCircle(x+4,y-2,3,WHITE);
  }
}

void drawsun(int x, int y, int color, int BIG=false){
  if(BIG){
    //Oled.fillCircle(x,y,40,WHITE);
    //Oled.fillCircle(x,y,20,color);
    //Horizontals
    //drawHomoRectY(x+50,y,x+60,y,4,WHITE);
    //drawHomoRectY(x-50,y,x-60,y,4,WHITE);
    //Verticals
    //drawHomoRectX(x,y+50,x,y+60,4,WHITE);
    //drawHomoRectX(x,y-50,x,y-60,4,WHITE);
    //y = x, y = -x
    //drawHomoRectXYP(x-40,y-40,(x)-48,(y)-48,3,WHITE);
    //drawHomoRectXY(x+40,y-40,(x)+48,(y)-48,3,GREEN);
    //drawHomoRectXYP(x+40,y+40,(x)+48,(y)+48,3,RED);
    //drawHomoRectXY(x-40,y+40,(x)-48,(y)+48,3,BLUE);
    Oled.drawBitmap(0, 0, sunlogo, 128, 128, WHITE);
  }
  else{
    Oled.fillCircle(x,y,4,WHITE);
    Oled.fillCircle(x,y,2,color);
    //Horizontals
    Oled.drawLine(x+6,y,x+9,y,WHITE);
    Oled.drawLine(x-6,y,x-9,y,WHITE);
    //Verticals
    Oled.drawLine(x,y+6,x,y+9,WHITE);
    Oled.drawLine(x,y-6,x,y-9,WHITE);
    //y = x, y = -x
    Oled.drawLine(x-5,y-5,(x)-7,(y)-7,WHITE);
    Oled.drawLine(x+5,y-5,(x)+7,(y)-7,WHITE);
    Oled.drawLine(x+5,y+5,(x)+7,(y)+7,WHITE);
    Oled.drawLine(x-5,y+5,(x)-7,(y)+7,WHITE);
  }
}

void drawmusic(int x, int y, int color, int BIG=false){
  if(BIG){
    Oled.drawBitmap(0, 0, musiclogo, 128, 128, WHITE);
  }
  else{
    
    Oled.fillCircle(x-4,y+4,2,WHITE);
    Oled.fillCircle(x+4,y+4,2,WHITE);
    
    Oled.drawLine(x-2,y+4,x-2,y-5,WHITE);
    Oled.drawLine(x+6,y+4,x+6,y-5,WHITE);
    
    Oled.drawLine(x-2,y-5,x+6,y-5,WHITE);
    Oled.drawLine(x-2,y-4,x+6,y-4,WHITE);
    Oled.drawLine(x-2,y-6,x+6,y-6,WHITE);
  }
}

void drawpong(int x, int y, int color, int BIG=false){
  if(BIG){
    Oled.fillCircle(x-30,y,15, WHITE);
    Oled.fillRect(x+20,y-50,20,90,WHITE);
  }
  else{
    
    Oled.fillCircle(x-5,y,2, WHITE);
    Oled.fillRect(x+2,y-5,3,11,WHITE);
  }
}

void drawlight(int x, int y, int color, int BIG=false){
  if(BIG){
    Oled.drawBitmap(0, 0, flash_b, 128, 128, WHITE);
  }
  else{
    
    Oled.fillRect(x-4,y-7,9,6,WHITE);
    Oled.fillRect(x-2,y-7,5,16,WHITE);
    
  }
}

void drawtimer(int x, int y, int color, int BIG=false){
  if(BIG){
    Oled.fillCircle(x,y,40,WHITE);
    Oled.fillCircle(x,y,37,color);
    Oled.drawLine(x,y,x,y-40,WHITE);
    Oled.fillRect(x-14,y-45,30,10,WHITE);
  }
  else{
    
    Oled.drawCircle(x,y,8,WHITE);
    Oled.drawCircle(x,y,7,color);
    Oled.drawLine(x,y,x,y-8,WHITE);
    Oled.fillRect(x-2,y-9,5,3,WHITE);
  }
}

void drawengine(int x, int y, int color, int BIG=false){
  if(BIG){
    Oled.drawBitmap(0, 0, gear_b, 128, 128, WHITE);
  }
  else{
    Oled.drawBitmap(x-9, y-9, gear_s, 19, 19, WHITE);

    //drawHomoRectXY(x-5,y+5,x,y,1,WHITE);
    //Oled.drawCircle(x+2,y-2,4,WHITE);
    //Oled.drawCircle(x+3,y-3,1,color);
  }
}

void choosebitmap(int bitmap, int x, int y, int color, boolean BIG = false){
  switch (bitmap){
    case 0:
      drawlocation(x,y,color,BIG);
      break;
    case 1:
      drawheart(x,y,color, BIG);
      break;
    case 2:
      drawsun(x,y,color,BIG);
      break;
    case 3:
      drawmusic(x,y,color,BIG);
      break;
    case 4:
      drawpong(x,y,color,BIG);
      break;
    case 5:
      drawtimer(x,y,color,BIG);
      break;
    case 6: 
      drawlight(x,y,color,BIG);
      break;
    case 7:
      drawengine(x,y,color,BIG);
      break;
  }
}


void select_function(int number){
  loadscreen(number);
  switch (number){
    case 0:
      nav();
      break;
    case 1:
      heart_monitor();
      break;
    case 2:
      showWeather();
      break;
    case 3:
      spotify();
      break;
    case 4:
      pong();
      break;
    case 5:
      stopwatch();
      break;
    case 6:
      flashlight_submenu();
      break;
    case 7:
      settings();
      break;
  }
  
}


void top_title(String mssg){
  Oled.fillScreen(BLACK);
  Oled.setTextColor(color);
  Oled.setFont(&Orbitron_Medium_20);
  drawCentreString(mssg, 64, 14);
  Oled.fillRect(0, 18, 128, 2, color);
}

void drawApps(){

  for (int i=0; i<8; i++){
    Oled.fillCircle(posx[i],posy[i],12,colorapp[i]);
    choosebitmap(i,posx[i],posy[i],colorapp[i]);
    //drawlocation(posx[i],posy[i],colorapp[i]);
  }
    
}

void hoverApp(int current, int prev = 0){

  Oled.fillCircle(posx[prev],posy[prev],17,BLACK);
  Oled.fillCircle(posx[prev],posy[prev],12,colorapp[prev]);
  choosebitmap(prev,posx[prev],posy[prev],colorapp[prev]);

  Oled.fillCircle(posx[current],posy[current],17,color);
  Oled.fillCircle(posx[current],posy[current],15,BLACK); 

  Oled.fillCircle(posx[current],posy[current],12,colorapp[current]); 
  choosebitmap(current,posx[current],posy[current],colorapp[current]);
}

void selectApp(int current){
  Oled.fillCircle(posx[current],posy[current],17,BLACK);
  Oled.fillCircle(posx[current],posy[current],15,color); 
  Oled.fillCircle(posx[current],posy[current],12,colorapp[current]);
  choosebitmap(current,posx[current],posy[current],colorapp[current]);
}

void loadscreen(int idx){
  Oled.fillScreen(colorapp[idx]);
  //drawlocation(64,64,colorapp[idx],true);
  choosebitmap(idx,64,64,colorapp[idx],true);
  //drawheart(64,64,colorapp[idx],true);
  delay(1000);
}

void drawedge(int index){
  Oled.fillCircle(0,0,30,colorapp[index]);
  choosebitmap(index, 12, 13, colorapp[index]);
}

void menu_(){

  selected = 0;
  
  int index = 0;
  int tri_inc=0;
  int y_inc = 0;

  
  beg_menuu:
    Oled.fillScreen(BLACK);
    Oled.setTextColor(color);
    Oled.setFont(&Orbitron_Bold_14);
    Oled.drawBitmap(40, 40, placitlogo, 50, 50, color);
    
  menuu:
    hoverApp(index);
    drawApps();
    
    wait_middle();
  
  waiting:
    wait_for_any_button();
  
  
    //// BUTTOM BUTTON
    if (digitalRead(b_button) ==  LOW){
      wait_bottom();
      if (index<7){
        index+=1;
        hoverApp(index, index-1);
      }
      else{
        index=0;
        hoverApp(index,7);
      }
      goto waiting;
    }
    //// END OF BOTTOM BUTTON
  
  
    //// TOP BUTTON
    else if (digitalRead(t_button) ==  LOW){
      wait_top();
      if (index>0){
        index-=1;
        hoverApp(index, index+1);
      }
      else{
        index=7;
        hoverApp(index,0);
      }
      goto waiting;
    }
    //// END OF TOP BUTTON
  
  
    //// MIDDLE BUTTON
    else if (digitalRead(m_button) ==  LOW){
      selectApp(index);
      wait = 0;
      while (digitalRead(m_button) ==  LOW){
        if (wait >= 1000){
          goto end_menu;
        }
        delay(10);
        wait += 10;
      }
      if(makeSound){buzzer();}
      delay(150);
      hoverApp(index);
      delay(250);
      selected = index;
      select_function(index);
      if (goto_main == 1){
        goto_main = 0;
        goto end_menu;
      }
      delay(250);
      goto beg_menuu;
    }
    //// END OF MIDDLE BUTTON


  end_menu:
    if(makeSound){buzzer();}
    Oled.fillScreen(BLACK);
    prevMinute = -1;
    prevHour = -1;
    prevSecond = -1;
    prevDay = "-1";
    v_prevhour = -1;
    v_prevminute = -1;
    v_prevsecond = -1;
    ampm = "None";
    selected = 0;
}
